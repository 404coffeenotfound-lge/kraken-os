## components/system/Kconfig
```kconfig
menu "System Service Configuration"

    config SYSTEM_SERVICE_MAX_SERVICES
        int "Maximum number of services"
        default 16
        range 1 64
        help
            Maximum number of services that can be registered with the system.

    config SYSTEM_SERVICE_MAX_EVENT_TYPES
        int "Maximum number of event types"
        default 64
        range 1 256
        help
            Maximum number of event types that can be registered.

    config SYSTEM_SERVICE_MAX_SUBSCRIBERS
        int "Maximum number of event subscribers"
        default 32
        range 1 128
        help
            Maximum number of concurrent event subscriptions.

    config SYSTEM_SERVICE_EVENT_QUEUE_SIZE
        int "Event queue size"
        default 32
        range 4 256
        help
            Size of the event queue for async event processing.

    config SYSTEM_SERVICE_MAX_DATA_SIZE
        int "Maximum event data size (bytes)"
        default 512
        range 64 4096
        help
            Maximum size of data payload for a single event.

    config SYSTEM_SERVICE_EVENT_TASK_STACK_SIZE
        int "Event task stack size (bytes)"
        default 4096
        range 2048 8192
        help
            Stack size for the event processing task.

    config SYSTEM_SERVICE_EVENT_TASK_PRIORITY
        int "Event task priority"
        default 5
        range 1 24
        help
            FreeRTOS task priority for event processing.

    config SYSTEM_SERVICE_HEARTBEAT_TIMEOUT_MS
        int "Service heartbeat timeout (ms)"
        default 30000
        range 1000 300000
        help
            Time in milliseconds before a service is considered unresponsive.

    menu "Watchdog Configuration"
        
        config SYSTEM_SERVICE_ENABLE_WATCHDOG
            bool "Enable service watchdog"
            default y
            help
                Enable watchdog monitoring for service health.
        
        config SYSTEM_SERVICE_WATCHDOG_TASK_PRIORITY
            int "Watchdog task priority"
            default 10
            range 1 24
            depends on SYSTEM_SERVICE_ENABLE_WATCHDOG
            help
                FreeRTOS task priority for watchdog monitoring.
        
        config SYSTEM_SERVICE_WATCHDOG_CHECK_INTERVAL_MS
            int "Watchdog check interval (ms)"
            default 5000
            range 1000 60000
            depends on SYSTEM_SERVICE_ENABLE_WATCHDOG
            help
                How often the watchdog checks service heartbeats.
        
        config SYSTEM_SERVICE_WATCHDOG_AUTO_RESTART
            bool "Auto-restart failed services"
            default y
            depends on SYSTEM_SERVICE_ENABLE_WATCHDOG
            help
                Automatically restart services that timeout.
        
        config SYSTEM_SERVICE_WATCHDOG_MAX_RESTARTS
            int "Maximum restart attempts"
            default 3
            range 0 10
            depends on SYSTEM_SERVICE_WATCHDOG_AUTO_RESTART
            help
                Maximum number of restart attempts before giving up.
    
    endmenu

    menu "Event Handler Monitoring"
        
        config SYSTEM_SERVICE_ENABLE_HANDLER_MONITORING
            bool "Enable event handler monitoring"
            default y
            help
                Monitor event handler execution time.
        
        config SYSTEM_SERVICE_HANDLER_WARN_THRESHOLD_MS
            int "Handler warning threshold (ms)"
            default 50
            range 10 1000
            depends on SYSTEM_SERVICE_ENABLE_HANDLER_MONITORING
            help
                Log warning if handler exceeds this time.
        
        config SYSTEM_SERVICE_HANDLER_TIMEOUT_MS
            int "Handler timeout (ms, 0=disabled)"
            default 0
            range 0 5000
            depends on SYSTEM_SERVICE_ENABLE_HANDLER_MONITORING
            help
                Force return if handler exceeds this time (0=disabled).
    
    endmenu

    menu "Resource Quotas"
        
        config SYSTEM_SERVICE_ENABLE_QUOTAS
            bool "Enable resource quotas"
            default y
            help
                Enable per-service resource quota enforcement.
        
        config SYSTEM_SERVICE_DEFAULT_EVENT_QUOTA_PER_SEC
            int "Default events per second quota"
            default 100
            range 10 10000
            depends on SYSTEM_SERVICE_ENABLE_QUOTAS
            help
                Default maximum events a service can post per second.
        
        config SYSTEM_SERVICE_DEFAULT_SUBSCRIPTION_QUOTA
            int "Default subscription quota"
            default 16
            range 1 64
            depends on SYSTEM_SERVICE_ENABLE_QUOTAS
            help
                Default maximum subscriptions per service.
        
        config SYSTEM_SERVICE_DEFAULT_MEMORY_QUOTA_KB
            int "Default memory quota (KB)"
            default 64
            range 4 1024
            depends on SYSTEM_SERVICE_ENABLE_QUOTAS
            help
                Default maximum memory allocation per service.
    
    endmenu

    menu "Memory Pool Configuration"
        
        config SYSTEM_SERVICE_ENABLE_MEMORY_POOLS
            bool "Enable memory pools for events"
            default y
            help
                Use pre-allocated memory pools to reduce fragmentation.
        
        config SYSTEM_SERVICE_POOL_SIZE_64
            int "Pool size for 64-byte blocks"
            default 16
            range 0 64
            depends on SYSTEM_SERVICE_ENABLE_MEMORY_POOLS
            help
                Number of 64-byte blocks in memory pool.
        
        config SYSTEM_SERVICE_POOL_SIZE_128
            int "Pool size for 128-byte blocks"
            default 16
            range 0 64
            depends on SYSTEM_SERVICE_ENABLE_MEMORY_POOLS
            help
                Number of 128-byte blocks in memory pool.
        
        config SYSTEM_SERVICE_POOL_SIZE_256
            int "Pool size for 256-byte blocks"
            default 8
            range 0 32
            depends on SYSTEM_SERVICE_ENABLE_MEMORY_POOLS
            help
                Number of 256-byte blocks in memory pool.
        
        config SYSTEM_SERVICE_POOL_SIZE_512
            int "Pool size for 512-byte blocks"
            default 8
            range 0 32
            depends on SYSTEM_SERVICE_ENABLE_MEMORY_POOLS
            help
                Number of 512-byte blocks in memory pool.
    
    endmenu

    menu "Performance & Metrics"
        
        config SYSTEM_SERVICE_ENABLE_METRICS
            bool "Enable performance metrics"
            default y
            help
                Track and report performance metrics.
        
        config SYSTEM_SERVICE_ENABLE_LATENCY_TRACKING
            bool "Enable event latency tracking"
            default y
            depends on SYSTEM_SERVICE_ENABLE_METRICS
            help
                Track event processing latency.
        
        config SYSTEM_SERVICE_ENABLE_QUEUE_STATS
            bool "Enable queue statistics"
            default y
            depends on SYSTEM_SERVICE_ENABLE_METRICS
            help
                Track event queue depth and overflow statistics.
    
    endmenu

    menu "Priority Queue Configuration"
        
        config SYSTEM_SERVICE_ENABLE_PRIORITY_QUEUES
            bool "Enable priority-based event queues"
            default y
            help
                Use separate queues for different priority levels.
        
        config SYSTEM_SERVICE_HIGH_PRIORITY_QUEUE_SIZE
            int "High priority queue size"
            default 16
            range 4 128
            depends on SYSTEM_SERVICE_ENABLE_PRIORITY_QUEUES
            help
                Size of high priority event queue.
        
        config SYSTEM_SERVICE_NORMAL_PRIORITY_QUEUE_SIZE
            int "Normal priority queue size"
            default 32
            range 4 128
            depends on SYSTEM_SERVICE_ENABLE_PRIORITY_QUEUES
            help
                Size of normal priority event queue.
        
        config SYSTEM_SERVICE_LOW_PRIORITY_QUEUE_SIZE
            int "Low priority queue size"
            default 16
            range 4 128
            depends on SYSTEM_SERVICE_ENABLE_PRIORITY_QUEUES
            help
                Size of low priority event queue.
    
    endmenu

endmenu
```

## sdkconfig.defaults
```kconfig
CONFIG_IDF_TARGET="esp32s3"
CONFIG_PARTITION_TABLE_CUSTOM=y
CONFIG_PARTITION_TABLE_CUSTOM_FILENAME="partitions.csv"

# Bluetooth - BLE only (ESP32S3 supports BLE)

# WiFi - Disable all WPA3 features
CONFIG_ESP_WIFI_ENABLE_WPA3_SAE=n
CONFIG_ESP_WIFI_SOFTAP_SAE_SUPPORT=n
CONFIG_ESP_WIFI_ENABLE_WPA3_OWE_STA=n
CONFIG_WPA_SUITE_B_192=n
CONFIG_WPA_11KV_SUPPORT=n
CONFIG_WPA_MBO_SUPPORT=n
CONFIG_WPA_11R_SUPPORT=n

# WiFi - Reduced buffers
CONFIG_ESP_WIFI_STATIC_RX_BUFFER_NUM=4
CONFIG_ESP_WIFI_DYNAMIC_RX_BUFFER_NUM=8
CONFIG_ESP_WIFI_DYNAMIC_TX_BUFFER_NUM=8
CONFIG_ESP_WIFI_AMPDU_TX_ENABLED=n
CONFIG_ESP_WIFI_AMPDU_RX_ENABLED=n
CONFIG_ESP_WIFI_RX_IRAM_OPT=n
CONFIG_ESP_WIFI_IRAM_OPT=n

# PSRAM - Strategy: Explicit allocation for apps, SRAM reserved for system
CONFIG_SPIRAM=y
CONFIG_SPIRAM_MODE_OCT=y
CONFIG_SPIRAM_SPEED_80M=y
# Use CAPS allocator - apps must explicitly request PSRAM via heap_caps_malloc
CONFIG_SPIRAM_USE_CAPS_ALLOC=y
# Allow BSS in PSRAM for app static buffers (use EXT_RAM_BSS_ATTR)
CONFIG_SPIRAM_ALLOW_BSS_SEG_EXTERNAL_MEMORY=y
# Reserve minimum SRAM for system services (keep critical services fast)
CONFIG_SPIRAM_MALLOC_ALWAYSINTERNAL=16384
# Keep WiFi/LWIP in SRAM for performance (system service)
# CONFIG_SPIRAM_TRY_ALLOCATE_WIFI_LWIP is not set

# Memory optimizations
CONFIG_FREERTOS_PLACE_FUNCTIONS_INTO_FLASH=y
CONFIG_FREERTOS_PLACE_SNAPSHOT_FUNS_INTO_FLASH=y
CONFIG_LWIP_IRAM_OPTIMIZATION=n

# Size optimization
CONFIG_COMPILER_OPTIMIZATION_SIZE=y
CONFIG_LOG_DEFAULT_LEVEL_INFO=y
CONFIG_BOOTLOADER_LOG_LEVEL_WARN=y
CONFIG_ESPTOOLPY_FLASHSIZE_8MB=y

# LVGL Display Settings - Clean and sharp
CONFIG_LV_DPI_DEF=100
CONFIG_LV_FONT_MONTSERRAT_12=y
CONFIG_LV_FONT_MONTSERRAT_14=y
CONFIG_LV_FONT_MONTSERRAT_16=y
CONFIG_LV_FONT_DEFAULT_MONTSERRAT_14=y
# Disable subpixel rendering
# CONFIG_LV_FONT_SUBPX is not set
# Color settings
CONFIG_LV_COLOR_16_SWAP=n
# Enable execution from PSRAM (required for dynamic apps)
CONFIG_SPIRAM_FETCH_INSTRUCTIONS=y
CONFIG_SPIRAM_RODATA=y
CONFIG_SPIRAM_INSTRUCTION_CACHE_SIZE=16384

# Move code to flash to free IRAM for dynamic apps
CONFIG_FREERTOS_PLACE_FUNCTIONS_INTO_FLASH=y
CONFIG_ESP_WIFI_IRAM_OPT=n
CONFIG_ESP_WIFI_RX_IRAM_OPT=n
CONFIG_SPI_FLASH_ROM_IMPL=y
CONFIG_BOOTLOADER_RESERVE_RTC_SIZE=0
CONFIG_SPIRAM_XIP_FROM_PSRAM=y
# Bluetooth Configuration
CONFIG_BT_ENABLED=y
CONFIG_BT_BLUEDROID_ENABLED=y
CONFIG_BT_BLE_ENABLED=y
CONFIG_BT_GATTS_ENABLE=y
CONFIG_BT_GATT_MAX_SR_PROFILES=8
CONFIG_BT_GATT_MAX_SR_ATTRIBUTES=100
CONFIG_BLE_ADV_REPORT_FLOW_CTRL_SUPP=y
CONFIG_BLE_ADV_REPORT_FLOW_CTRL_NUM=100
CONFIG_BT_ACL_CONNECTIONS=4
# Enable BLE 4.2 advertising (required for esp_ble_gap_start_advertising)
CONFIG_BT_BLE_42_FEATURES_SUPPORTED=y

# Bluetooth controller
CONFIG_BTDM_CTRL_MODE_BLE_ONLY=y
CONFIG_BTDM_CTRL_MODE_BR_EDR_ONLY=n
CONFIG_BTDM_CTRL_MODE_BTDM=n

# Bluetooth stack
CONFIG_BT_STACK_NO_LOG=n
CONFIG_BT_LOG_HCI_TRACE_LEVEL_WARNING=y
```
